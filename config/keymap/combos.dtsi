combos {
	compatible = "zmk,combos";
	combo_caps {
		timeout-ms = <500>;
		key-positions = <LF4 LT1>;
		bindings = <&caps_word>;
	};
	combo_cap {
		timeout-ms = <500>;
		key-positions = <LM3 RT1>;
		bindings = <&kp N9 &kp N1>;
		layers = <LAYER_Numbers>;
	};
};

