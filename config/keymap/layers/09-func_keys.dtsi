layer_FuncKeys {
    bindings = <
        &trans          &trans          &trans          &trans          &trans                                                                                                                                          &trans          &trans          &trans          &trans          &none
        &trans          &trans          &trans          &trans          &trans          &trans                                                                                                          &trans          &kp F10         &kp F11         &kp F12         &trans          &none
        &trans          &trans          &trans          &none           &none           &trans                                                                                                          &trans          &kp F7          &kp F8          &kp F9          &trans          &none
        &trans          &trans          &trans          &trans          &trans          &trans                                                                                                          &trans          &kp F4          &kp F5          &kp F6          &trans          &none
        &trans          &trans          &trans          &trans          &trans          &trans          &trans          &none           &trans          &trans          &kp LCTRL       &kp LSHIFT      &trans          &kp F1          &kp F2          &kp F3          &trans          &none
        &trans          &trans          &trans          &trans          &trans                          &trans          &trans          &trans          &trans          &trans          &trans                          &trans          &trans          &trans          &trans          &none
    >;
};
