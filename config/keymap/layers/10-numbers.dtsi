layer_Numbers {
    bindings = <
        &trans          &trans          &trans          &trans          &trans                                                                                                                                          &trans          &trans          &trans          &trans          &none
        &trans          &trans          &trans          &trans          &trans          &trans                                                                                                          &trans          &trans          &trans          &trans          &trans          &none
        &trans          &trans          &trans          &trans          &trans          &trans                                                                                                          &trans          &kp N7          &kp N8          &kp N9          &trans          &none
        &trans          &kp LC(A)       &trans          &trans          &trans          &trans                                                                                                          &trans          &kp N4          &kp N5          &kp N6          &kp N0          &none
        &trans          &trans          &trans          &trans          &kp DOT         &trans          &trans          &trans          &trans          &trans          &kp LCTRL       &mo LAYER_FuncKeys &trans       &kp N1          &kp N2          &kp N3          &trans          &none
        &trans          &trans          &trans          &trans          &trans                          &trans          &trans          &trans          &trans          &trans          &trans                          &trans          &trans          &trans          &trans          &none
    >;
};
