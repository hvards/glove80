layer_LMT {
    bindings = <
        &trans          &trans          &trans          &trans          &trans                                                                                                                                          &trans          &trans          &trans          &trans          &trans
        &trans          &trans          &trans          &trans          &trans          &trans                                                                                                          &trans          &trans          &trans          &trans          &trans          &trans
        &trans          &trans          &trans          &kp LS(COMMA)   &kp LS(N6)      &trans                                                                                                          &trans          &kp LS(N4)      &kp LS(DOT)     &trans          &trans          &trans
        &trans          &trans          &kp LBKT        &kp LS(LBKT)    &kp LS(N9)      &trans                                                                                                          &trans          &kp LS(N0)      &kp LS(RBKT)    &kp RBKT        &kp LS(SEMI)    &trans
        &trans          &trans          &kp TAB         &kp LC(TAB)     &kp LA(TAB)     &trans          &trans          &kp LALT        &trans          &trans          &trans          &kp LSHIFT      &trans          &trans          &trans          &trans          &trans          &trans
        &trans          &trans          &trans          &trans          &trans                          &trans          &trans          &trans          &trans          &trans          &trans                          &trans          &trans          &trans          &trans          &trans
    >;
};

layer_RMT {
    bindings = <
        &trans          &trans          &trans          &trans          &trans                                                                                                                                          &trans          &trans          &trans          &trans          &trans
        &trans          &trans          &trans          &trans          &trans          &trans                                                                                                          &trans          &trans          &trans          &trans          &trans          &trans
        &trans          &trans          &trans          &trans          &kp LS(N3)      &trans                                                                                                          &trans          &trans          &trans          &trans          &trans          &trans
        &trans          &kp LS(N2)      &kp LS(N1)      &kp LS(N8)      &trans          &trans                                                                                                          &trans          &trans          &kp LS(N7)      &trans          &trans          &trans
        &trans          &trans          &trans          &trans          &kp LS(N4)      &trans          &trans          &trans          &trans          &trans          &trans          &trans          &trans          &trans          &trans          &trans          &trans          &trans
        &trans          &trans          &trans          &trans          &trans                          &trans          &trans          &trans          &trans          &trans          &trans                          &trans          &trans          &trans          &trans          &trans
    >;
};
