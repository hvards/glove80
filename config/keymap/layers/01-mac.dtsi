layer_Mac {
    bindings = <
        &trans          &trans          &trans          &trans          &trans                                                                                                                                          &trans          &trans          &trans          &trans          &trans
        &kp NUBS        &trans          &trans          &trans          &trans          &trans                                                                                                          &trans          &trans          &trans          &trans          &trans          &trans
        &trans          &trans          &trans          &trans          &trans          &trans                                                                                                          &trans          &trans          &trans          &trans          &trans          &trans
        &kp ESC         &hml LCTRL A     &hml LALT R    &hml LSHIFT S   &hml LGUI T     &kp G                                                                                                           &kp M           &hmr LGUI N     &hmr LSHIFT E   &hmr LALT I     &hmr LCTRL O    &kp SQT
        &trans          &trans          &trans          &trans          &trans          &trans          &trans          &trans          &trans          &trans          &trans          &trans          &trans          &trans          &trans          &trans          &trans          &trans
        &trans          &trans          &trans          &kp BSLH        &trans                          &trans          &kp GLOBE       &trans          &trans          &trans          &trans                          &trans          &trans          &trans          &trans          &trans
    >;
};