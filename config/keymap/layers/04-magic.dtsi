layer_Magic {
    bindings = <
        &bt BT_CLR      &none           &none           &none          &none                                                                                                                                            &none           &none           &none           &none           &bt BT_CLR_ALL
        &none           &none           &none           &none          &none            &none                                                                                                           &none           &none           &none           &none           &none           &none
        &none           &rgb_ug RGB_SPI &rgb_ug RGB_SAI &rgb_ug RGB_HUI &rgb_ug RGB_BRI &rgb_ug RGB_TOG                                                                                                 &none           &none           &none           &none           &none           &none
        &bootloader     &rgb_ug RGB_SPD &rgb_ug RGB_SAD &rgb_ug RGB_HUD &rgb_ug RGB_BRD &rgb_ug RGB_EFF                                                                                                 &none           &none           &none           &none           &none           &bootloader
        &sys_reset      &none           &none           &none          &none            &none           &bt_2           &bt_3           &none           &none           &none           &none           &none           &none           &none           &none           &none           &sys_reset
        &none           &none           &none           &none          &none                            &bt_0           &bt_1           &out OUT_USB    &none           &none           &none                           &none           &none           &none           &none           &none
    >;
};