layer_Lower {
    bindings = <
        &kp C_BRI_DN    &kp C_BRI_UP    &kp C_PREV      &kp C_NEXT      &kp C_PP                                                                                                                                        &kp C_MUTE      &kp C_VOL_DN    &kp C_VOL_UP    &none           &kp PAUSE_BREAK
        &trans          &none           &none           &none           &none           &kp HOME                                                                                                   &kp LEFT_PARENTHESIS &kp N7          &kp N8          &kp N9          &kp KP_MULTIPLY &kp PRINTSCREEN
        &trans          &none           &none           &kp UP_ARROW    &none           &kp END                                                                                                   &kp RIGHT_PARENTHESIS &kp N4          &kp N5          &kp N6          &kp KP_MINUS    &kp SCROLLLOCK
        &trans          &none           &kp LEFT_ARROW  &kp DOWN_ARROW  &kp RIGHT_ARROW &kp PG_UP                                                                                                       &kp PERCENT     &kp N1          &kp N2          &kp N3          &kp KP_PLUS     &none
        &trans          &kp K_APP       &none           &kp F11         &kp F12         &kp PG_DN       &trans          &trans          &to 0           &trans          &trans          &trans          &kp COMMA       &kp N0          &kp N0          &kp KP_DOT      &kp KP_ENTER    &trans
        &magic LAYER_Magic 0 &tog LAYER_Mac &tog LAYER_Linux &kp K_APP  &kp F12                         &trans          &trans          &trans          &trans          &trans          &trans                          &kp N0          &kp N0          &kp KP_DOT      &kp KP_ENTER    &trans
    >;
};