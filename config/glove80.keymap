#include <behaviors.dtsi>
#include <dt-bindings/zmk/bt.h>
#include <dt-bindings/zmk/keys.h>
#include <dt-bindings/zmk/outputs.h>
#include <dt-bindings/zmk/rgb.h>
#include <dt-bindings/zmk/pointing.h>
#include "keylabel.h"

#define ZMK_POINTING_DEFAULT_MOVE_VAL 2000
#define ZMK_POINTING_DEFAULT_SCRL_VAL 30

#define LAYER_Base 0
#define LAYER_Mac 1
#define LAYER_Linux 2
#define LAYER_Lower 3
#define LAYER_Magic 4
#define LAYER_Special 5
#define LAYER_Mouse 6
#define LAYER_Mouse2 7
#define LAYER_Mouse3 8
#define LAYER_FuncKeys 9
#define LAYER_Numbers 10
#define LAYER_LMT 11
#define LAYER_RMT 12
#define LAYER_Mirror 13
#define LAYER_Macro0 14
#define LAYER_Macro1 15
#define LAYER_Macro2 16
#define LAYER_Macro3 17

#include "keymap/configuration.dtsi"

/ {
    #include "keymap/behaviors.dtsi"
    #include "keymap/macros.dtsi"
	#include "keymap/combos.dtsi"
    
    keymap {
        compatible = "zmk,keymap";

        #include "keymap/layers/00-base.dtsi"
        #include "keymap/layers/01-mac.dtsi"
        #include "keymap/layers/02-linux.dtsi"
        #include "keymap/layers/03-layer_lower.dtsi"
        #include "keymap/layers/04-magic.dtsi"
        #include "keymap/layers/05-special.dtsi"
        #include "keymap/layers/06-mouse.dtsi"
        #include "keymap/layers/09-func_keys.dtsi"
        #include "keymap/layers/10-numbers.dtsi"
        #include "keymap/layers/11-lrmt.dtsi"
        #include "keymap/layers/13-mirror.dtsi"
        #include "keymap/layers/14-macro_layers.dtsi"
    };
};

//&none           &none           &none           &none           &none                                                                                                                                           &none           &none           &none           &none           &none
//&none           &none           &none           &none           &none           &none                                                                                                           &none           &none           &none           &none           &none           &none
//&none           &none           &none           &none           &none           &none                                                                                                           &none           &none           &none           &none           &none           &none
//&none           &none           &none           &none           &none           &none                                                                                                           &none           &none           &none           &none           &none           &none
//&none           &none           &none           &none           &none           &none           &none           &none           &none           &none           &none           &none           &none           &none           &none           &none           &none           &none
//&none           &none           &none           &none           &none                           &none           &none           &none           &none           &none           &none                           &none           &none           &none           &none           &none
